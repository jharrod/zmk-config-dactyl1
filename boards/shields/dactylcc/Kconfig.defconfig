## boards/shields/dactylcc/Kconfig.defconfig
```kconfig
# Copyright (c) 2022 The ZMK Contributors
# SPDX-License-Identifier: MIT

if SHIELD_DACTYLCC_LEFT

	config ZMK_KEYBOARD_NAME
		default "DactylCC"

	config ZMK_SPLIT_ROLE_CENTRAL
		default y

endif

if SHIELD_DACTYLCC_LEFT || SHIELD_DACTYLCC_RIGHT

	config ZMK_SPLIT
		default y

endif
```

## boards/shields/dactylcc/Kconfig.shield
```kconfig
config SHIELD_DACTYLCC_LEFT
    def_bool $(shields_list_contains,dactylcc_left)

config SHIELD_DACTYLCC_RIGHT
    def_bool $(shields_list_contains,dactylcc_right)
```

## boards/shields/tbkmini/Kconfig.shield
```kconfig
config SHIELD_TBKMINI_LEFT
    def_bool $(shields_list_contains,dactylcc_left)

config SHIELD_TBKMINI_RIGHT
    def_bool $(shields_list_contains,dactylcc_right)
```
